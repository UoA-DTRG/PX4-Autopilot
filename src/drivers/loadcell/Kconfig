## src/drivers/loadcell/Kconfig
```kconfig
menuconfig DRIVERS_LOADCELL
	bool "loadcell"
	default n
	---help---
		Enable support for loadcell
```

## src/drivers/loadcelldriver/Kconfig
```kconfig
menuconfig DRIVERS_LOADCELLDRIVER
	bool "loadcelldriver"
	default n
	---help---
		Enable support for loadcelldriver
```

## src/examples/dtrg_test/Kconfig
```kconfig
 menuconfig EXAMPLES_DTRG_TEST
	bool "DTRG_TEST"
	default n
	---help---
		Enable dtrg test app
```

## src/modules/dynamixel_serial/Kconfig
```kconfig
menuconfig MODULES_DYNAMIXEL_SERIAL
	bool "dynamixel_serial"
	default n
	---help---
		Enable support for dynamixel_serial
```

## src/modules/sun_scale_control/Kconfig
```kconfig
menuconfig MODULES_SUN_SCALE_CONTROL
	bool "sun_scale_control"
	default n
	---help---
		Enable support for sun_scale_control

menuconfig USER_SUN_SCALE_CONTROL
	bool "sun_scale_control running as userspace module"
	default y
	depends on BOARD_PROTECTED && MODULES_SUN_SCALE_CONTROL
	---help---
		Put sun_scale_control in userspace memory
```
