## src/modules/admittance_control/Kconfig
```kconfig
menuconfig MODULES_ADMITTANCE_CONTROL
	bool "admittance_control"
	default n
	---help---
		Enable support for admittance_control
```

## src/modules/bench_test/Kconfig
```kconfig
menuconfig MODULES_BENCH_TEST
	bool "bench_test"
	default n
	---help---
		Enable support for bench_test flight mode.
		Injects hover / step / ramp signals directly into
		vehicle_thrust_setpoint and vehicle_torque_setpoint for
		system identification on a rigidly mounted vehicle.
```

## src/modules/effectiveness_estimator/Kconfig
```kconfig
menuconfig MODULES_EFFECTIVENESS_ESTIMATOR
	bool "effectiveness_estimator"
	default n
	---help---
		Enable support for effectiveness_estimator

menuconfig USER_EFFECTIVENESS_ESTIMATOR
	bool "effectiveness_estimator running as userspace module"
	default y
	depends on BOARD_PROTECTED && MODULES_EFFECTIVENESS_ESTIMATOR
	---help---
		Put effectiveness_estimator in userspace memory
```

## src/modules/multisine_excitation/Kconfig
```kconfig
menuconfig MODULES_MULTISINE_EXCITATION
	bool "multisine_excitation"
	default n
	---help---
		Enable support for orthogonal multisine excitation signal
		generation for RLS system identification. This module
		generates excitation signals that are applied to motor
		outputs by the control allocator.
```

## src/modules/rls_wrench_estimator/Kconfig
```kconfig
menuconfig MODULES_RLS_WRENCH_ESTIMATOR
	bool "rls_wrench_estimator"
	default n
	---help---
		Enable support for rls_wrench_estimator
```
